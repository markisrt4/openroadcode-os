## meta-openroadcode/conf/distro/openroadcode.conf
```bitbake
require conf/distro/poky.conf

DISTRO = "openroadcode"
DISTRO_NAME = "OpenRoadCode"
DISTRO_VERSION = "0.1"
DISTRO_CODENAME = "initial"

DISTRO_FEATURES:append = " \
    bluetooth \
    wifi \
    systemd \
"

VIRTUAL-RUNTIME_init_manager = "systemd"
VIRTUAL-RUNTIME_initscripts = ""

INIT_MANAGER = "systemd"
```

## meta-openroadcode/conf/layer.conf
```bitbake
BBPATH .= ":${LAYERDIR}"

BBFILES += "${LAYERDIR}/recipes-*/*/*.bb \
            ${LAYERDIR}/recipes-*/*/*.bbappend"

BBFILE_COLLECTIONS += "openroadcode"
BBFILE_PATTERN_openroadcode = "^${LAYERDIR}/"
BBFILE_PRIORITY_openroadcode = "6"

LAYERDEPENDS_openroadcode = "core yocto"
LAYERSERIES_COMPAT_openroadcode = "scarthgap"
```
